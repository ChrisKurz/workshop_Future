## Kconfig
```
menu "Blinky at Workshop"
config BLINKY_TIME_ON
  int "The time the LED is on (ms)."
  default 1000
endmenu
menu "Zephyr Kernel"
source "Kconfig.zephyr"
endmenu
```

## prj.conf
```kconfig
CONFIG_GPIO=y

# Enable Logging
CONFIG_LOG=y

CONFIG_BLINKY_TIME_ON=500
```

## src/main.c
```c
/*
 * Copyright (c) 2016 Intel Corporation
 *
 * SPDX-License-Identifier: Apache-2.0
 */

#include <stdio.h>
#include <zephyr/kernel.h>
#include <zephyr/drivers/gpio.h>

#include <zephyr/logging/log.h>

/* LOG MODULE REGISTRATION */
LOG_MODULE_REGISTER(MyApp,LOG_LEVEL_INF);


/* 1000 msec = 1 sec */
#define SLEEP_TIME_MS   1000

/* The devicetree node identifier for the "led0" alias. */
//#define LED0_NODE DT_ALIAS(led0)
//#define LED0_NODE DT_PATH(board_leds, my_led1)
#define LED0_NODE DT_NODELABEL(led3)

/*
 * A build error on this line means your board is unsupported.
 * See the sample documentation for information on how to fix this.
 */
static const struct gpio_dt_spec led = GPIO_DT_SPEC_GET(LED0_NODE, gpios);

int main(void)
{
	int ret;
	bool led_state = true;

	if (!gpio_is_ready_dt(&led)) {
		return 0;
	}

	ret = gpio_pin_configure_dt(&led, GPIO_OUTPUT_ACTIVE);
	if (ret < 0) {
		return 0;
	}

	while (1) {
		ret = gpio_pin_toggle_dt(&led);
		if (ret < 0) {
			return 0;
		}

		led_state = !led_state;
//		printf("LED state: %s\n", led_state ? "ON" : "OFF");
        LOG_INF("LED state: %s", led_state ? "ON" : "OFF");
//		k_msleep(SLEEP_TIME_MS);
		k_msleep(CONFIG_BLINKY_TIME_ON);		
	}
	return 0;
}
```
